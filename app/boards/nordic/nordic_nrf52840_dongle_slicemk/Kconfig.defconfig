## app/boards/nordic/nordic_nrf52840_dongle_slicemk/Kconfig.defconfig
```kconfig
if BOARD_NORDIC_NRF52840_DONGLE_SLICEMK

if USB

config USB_NRFX
    default y

config USB_DEVICE_STACK
    default y

endif # USB

config BT_CTLR
    default BT

endif # BOARD_NORDIC_NRF52840_DONGLE_SLICEMK
```

## app/boards/nordic/nordic_nrf52840_dongle_slicemk/board.yml
```yaml
boards:
  - name: nordic_nrf52840_dongle_slicemk
    full_name: Nordic nRF52840 Dongle SliceMK
    vendor: nordic
    socs:
      - name: nrf52840
        variants:
          - name: zmk
```

## app/boards/raytac/raytac_mdbt50q_cx_blue/Kconfig.defconfig
```kconfig
if BOARD_RAYTAC_MDBT50Q_CX_BLUE

if USB

config USB_NRFX
    default y

config USB_DEVICE_STACK
    default y

endif # USB

config BT_CTLR
    default BT

endif # BOARD_RAYTAC_MDBT50Q_CX_BLUE
```

## app/boards/raytac/raytac_mdbt50q_cx_blue/board.yml
```yaml
boards:
  - name: raytac_mdbt50q_cx_blue
    full_name: Raytac MDBT50Q-CX Blue
    vendor: raytac
    socs:
      - name: nrf52840
        variants:
          - name: zmk
```

## app/boards/raytac/raytac_mdbt50q_rx/Kconfig.raytac_mdbt50q_rx
```kconfig
config BOARD_RAYTAC_MDBT50Q_RX
    select SOC_NRF52840_QIAA
    select ZMK_BOARD_COMPAT
    imply RETAINED_MEM
    imply RETENTION
    imply RETENTION_BOOT_MODE
```

## app/boards/raytac/raytac_mdbt50q_rx/board.yml
```yaml
boards:
  - name: raytac_mdbt50q_rx
    full_name: Raytac MDBT50Q-RX
    vendor: raytac
    socs:
      - name: nrf52840
        variants:
          - name: zmk
```

## app/boards/raytac/raytac_mdbt50q_rx_green/Kconfig.raytac_mdbt50q_rx_green
```kconfig
config BOARD_RAYTAC_MDBT50Q_RX_GREEN
    select SOC_NRF52833_QIAA
    select ZMK_BOARD_COMPAT
    imply RETAINED_MEM
    imply RETENTION
    imply RETENTION_BOOT_MODE
```

## app/boards/raytac/raytac_mdbt50q_rx_green/board.yml
```yaml
boards:
  - name: raytac_mdbt50q_rx_green
    full_name: Raytac MDBT50Q-RX Green
    vendor: raytac
    socs:
      - name: nrf52833
        variants:
          - name: zmk
```

## app/boards/slicemk/slicemk_1551usb3_ms88sfa_blue/Kconfig.defconfig
```kconfig
if BOARD_SLICEMK_1551USB3_MS88SFA_BLUE

if USB

config USB_NRFX
    default y

config USB_DEVICE_STACK
    default y

endif # USB

config BT_CTLR
    default BT

endif # BOARD_SLICEMK_1551USB3_MS88SFA_BLUE
```

## app/boards/slicemk/slicemk_1551usb3_ms88sfa_blue/Kconfig.slicemk_1551usb3_ms88sfa_blue
```kconfig
config BOARD_SLICEMK_1551USB3_MS88SFA_BLUE
    select SOC_NRF52840_QIAA
    select ZMK_BOARD_COMPAT
    imply RETAINED_MEM
    imply RETENTION
    imply RETENTION_BOOT_MODE
```

## app/boards/slicemk/slicemk_1551usb3_ms88sfa_blue/board.yml
```yaml
boards:
  - name: slicemk_1551usb3_ms88sfa_blue
    full_name: SliceMK 1551USB3 MS88SFA Blue
    vendor: slicemk
    socs:
      - name: nrf52840
        variants:
          - name: zmk
```

## app/boards/slicemk/slicemk_ergodox_202104/board.yml
```yaml
boards:
  - name: slicemk_ergodox_202104
    full_name: SliceMK ErgoDox 202104
    vendor: slicemk
    socs:
      - name: nrf52840
        variants:
          - name: zmk
```

## app/boards/slicemk/slicemk_ergodox_202108_blue/Kconfig.defconfig
```kconfig
if BOARD_SLICEMK_ERGODOX_202108_BLUE_LEFT || BOARD_SLICEMK_ERGODOX_202108_BLUE_RIGHT

if USB

config USB_NRFX
    default y

config USB_DEVICE_STACK
    default y

endif # USB

config BT_CTLR
    default BT

endif # BOARD_SLICEMK_ERGODOX_202108_BLUE_LEFT || BOARD_SLICEMK_ERGODOX_202108_BLUE_RIGHT
```

## app/boards/slicemk/slicemk_ergodox_202108_blue/board.yml
```yaml
boards:
  - name: slicemk_ergodox_202108_blue_left
    full_name: SliceMK ErgoDox 202108 Blue Left
    vendor: slicemk
    socs:
      - name: nrf52840
        variants:
          - name: zmk
  - name: slicemk_ergodox_202108_blue_right
    full_name: SliceMK ErgoDox 202108 Blue Right
    vendor: slicemk
    socs:
      - name: nrf52840
        variants:
          - name: zmk
```

## app/boards/slicemk/slicemk_ergodox_202108_green/board.yml
```yaml
boards:
  - name: slicemk_ergodox_202108_green_left
    full_name: SliceMK ErgoDox 202108 Green Left
    vendor: slicemk
    socs:
      - name: nrf52833
        variants:
          - name: zmk
  - name: slicemk_ergodox_202108_green_right
    full_name: SliceMK ErgoDox 202108 Green Right
    vendor: slicemk
    socs:
      - name: nrf52833
        variants:
          - name: zmk
```

## app/boards/slicemk/slicemk_ergodox_202205_green/board.yml
```yaml
boards:
  - name: slicemk_ergodox_202205_green_left
    full_name: SliceMK ErgoDox 202205 Green Left
    vendor: slicemk
    socs:
      - name: nrf52833
        variants:
          - name: zmk
  - name: slicemk_ergodox_202205_green_right
    full_name: SliceMK ErgoDox 202205 Green Right
    vendor: slicemk
    socs:
      - name: nrf52833
        variants:
          - name: zmk
```

## app/boards/slicemk/slicemk_ergodox_202207_green/board.yml
```yaml
boards:
  - name: slicemk_ergodox_202207_green_left
    full_name: SliceMK ErgoDox 202207 Green Left
    vendor: slicemk
    socs:
      - name: nrf52833
        variants:
          - name: zmk
  - name: slicemk_ergodox_202207_green_right
    full_name: SliceMK ErgoDox 202207 Green Right
    vendor: slicemk
    socs:
      - name: nrf52833
        variants:
          - name: zmk
```

## app/boards/slicemk/slicemk_usbc_mdbt50q_blue/Kconfig.defconfig
```kconfig
if BOARD_SLICEMK_USBC_MDBT50Q_BLUE

if USB

config USB_NRFX
    default y

config USB_DEVICE_STACK
    default y

endif # USB

config BT_CTLR
    default BT

endif # BOARD_SLICEMK_USBC_MDBT50Q_BLUE
```

## app/boards/slicemk/slicemk_usbc_mdbt50q_blue/Kconfig.slicemk_usbc_mdbt50q_blue
```kconfig
config BOARD_SLICEMK_USBC_MDBT50Q_BLUE
    select SOC_NRF52840_QIAA
    select ZMK_BOARD_COMPAT
    imply RETAINED_MEM
    imply RETENTION
    imply RETENTION_BOOT_MODE
```

## app/boards/slicemk/slicemk_usbc_mdbt50q_blue/board.yml
```yaml
boards:
  - name: slicemk_usbc_mdbt50q_blue
    full_name: SliceMK USBC MDBT50Q Blue
    vendor: slicemk
    socs:
      - name: nrf52840
        variants:
          - name: zmk
```
